## arch/x86/hotplug/Kconfig
```kconfig
config ALUCARD_HOTPLUG
	bool "Enable alucard-hotplug cpu hotplug driver"
	default y
	help
	  Alucard-hotplug cpu hotplug driver

config MAKO_HOTPLUG
	bool "Enable mako-hotplug cpu hotplug driver"
	default y
	help
	  mako-hotplug cpu hotplug driver
```
